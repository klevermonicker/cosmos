#include "cosmotyl.dtsi"

/ {
    bootloader_key: bootloader_key {
        compatible = "zmk,boot-magic-key";
        key-position = <0>;
        jump-to-bootloader;
    };

    chosen {
        zmk,underglow = &led_strip;
    };
};
